## app/boards/arm/nrf52840_dongle/Kconfig.board
```kconfig
#
# Copyright (c) 2021 esbmasap.design
# SPDX-License-Identifier: MIT
#

config BOARD_NRF52840_DONGLE
	bool "nrf52840_dongle"
	depends on SOC_NRF52840_QIAA
```

## app/boards/arm/nrf52840_dongle/Kconfig.defconfig
```kconfig
#
# Copyright (c) 2021 esbmasap.design
# SPDX-License-Identifier: MIT
#

if BOARD_NRF52840_DONGLE

config BOARD
	default "nrf52480_dongle"

config BT_CTRL
	default bt

config ZMK_BLE
	default y

config ZMK_USB
	default y

if USB

config USB_NRFX
	default y

config USB_DEVICE_STACK
	default y

endif # USB

config BT_CTLR
	default BT

config ZMK_BLE
	default y

config ZMK_USB
	default y

endif # BOARD_NRF52840_DONGLE
```
